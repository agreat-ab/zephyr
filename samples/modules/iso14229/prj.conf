## CMakeLists.txt
```
# SPDX-License-Identifier: Apache-2.0

cmake_minimum_required(VERSION 3.20.0)

find_package(Zephyr REQUIRED HINTS $ENV{ZEPHYR_BASE})
project(ISO14229)

target_sources(app PRIVATE src/main.c)
```

## prj.conf
```kconfig
# general conf
CONFIG_GPIO=y

CONFIG_LOG=y
CONFIG_LOG_MODE_DEFERRED=y

CONFIG_REBOOT=y

# can conf
CONFIG_CAN=y
CONFIG_CAN_FD_MODE=y
CONFIG_CAN_MAX_FILTER=8

CONFIG_ISO14229=y
CONFIG_ISO14229_FUNC_RX_ID=0x7DF
CONFIG_ISO14229_LOG_LEVEL=0
CONFIG_ISO14229_RX_ID=0x7E8
CONFIG_ISO14229_TX_ID=0x7E0

CONFIG_UDS_CAN_BITRATE=500000
CONFIG_UDS_CAN_SAMPLEPOINT=750
```

## src/main.c
```c
#include <stdint.h>
#include <zephyr/kernel.h>
#include <zephyr/sys/reboot.h>
#include <zephyr/drivers/gpio.h>
#include <zephyr/lib/iso14229/uds.h>

#define SLEEP_TIME_MS 1000
#define LED0_NODE     DT_ALIAS(led0)

static const struct gpio_dt_spec led = GPIO_DT_SPEC_GET(LED0_NODE, gpios);

static struct k_work_delayable reboot_work;

static void do_reboot(struct k_work *work)
{
	sys_reboot(SYS_REBOOT_COLD);
}

UDSErr_t ecu_reset_handler(UDSServer_t *srv, UDSECUResetArgs_t *args, void *dummy)
{
	k_work_schedule(&reboot_work, K_MSEC(1000));
	return UDS_PositiveResponse;
}

int main(void)
{
	uint8_t ret = 0;

	if (!gpio_is_ready_dt(&led)) {
		return 0;
	}

	ret = gpio_pin_configure_dt(&led, GPIO_OUTPUT_ACTIVE);
	if (ret < 0) {
		return 0;
	}

	bool led_state = true;

	k_work_init_delayable(&reboot_work, do_reboot);

	ret = uds_register_ecureset_handler(UDS_EVT_EcuReset, ecu_reset_handler, NULL);
	if (ret < 0) {
		return 0;
	}

	ret = uds_init();
	if (ret < 0) {
		return 0;
	}

	for (;;) {
		k_sleep(K_MSEC(1000));
		led_state = !led_state;
	}
}
```

## src/shim.h
```c
#ifndef ISO14229_SHIM_H
#define ISO14229_SHIM_H

#include <stdint.h>

uint32_t UDSMillis(void);

#endif
```
